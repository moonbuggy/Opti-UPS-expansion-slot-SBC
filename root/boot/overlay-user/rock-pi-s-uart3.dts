/dts-v1/;
/plugin/;

/ {
  compatible = "radxa,rockpis\0rockchip,rk3308";

  fragment@0 {
    target = <0xffffffff>;

    __overlay__ {
      status = "disabled";
    };
  };

  fragment@1 {
    target = <0xffffffff>;

    __overlay__ {
      status = "disabled";
    };
  };

  fragment@2 {
    target = <0xffffffff>;

    __overlay__ {
      status = "okay";
    };
  };

  __fixups__ {
    i2c3 = "/fragment@0:target:0";
    spi1 = "/fragment@1:target:0";
    uart3 = "/fragment@2:target:0";
  };
};
